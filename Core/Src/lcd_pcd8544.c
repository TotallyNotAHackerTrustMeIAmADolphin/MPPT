#include "lcd_pcd8544.h"
#include <string.h>

/* Minimal 5x7 Font */
static const uint8_t font_5x7[][5] = {
    {0x00, 0x00, 0x00, 0x00, 0x00}, // space
    {0x00, 0x00, 0x5f, 0x00, 0x00}, // !
    {0x00, 0x07, 0x00, 0x07, 0x00}, // "
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    {0x44, 0x64, 0x54, 0x4c, 0x44}, // z
};

static void LCD_Write(LCD_Handle_t *hlcd, uint8_t data, uint8_t mode) {
    HAL_GPIO_WritePin(hlcd->port_dc, hlcd->pin_dc, mode); // 0 = Command, 1 = Data
    HAL_GPIO_WritePin(hlcd->port_ce, hlcd->pin_ce, GPIO_PIN_RESET);
    
    HAL_SPI_Transmit(hlcd->hspi, &data, 1, 10);
    
    // Ensure SPI is not busy before raising CE
    while (HAL_SPI_GetState(hlcd->hspi) == HAL_SPI_STATE_BUSY);
    HAL_GPIO_WritePin(hlcd->port_ce, hlcd->pin_ce, GPIO_PIN_SET);
}

void LCD_Init(LCD_Handle_t *hlcd) {
    /* Hard Reset */
    HAL_GPIO_WritePin(hlcd->port_rst, hlcd->pin_rst, GPIO_PIN_RESET);
    HAL_Delay(20); // Longer reset
    HAL_GPIO_WritePin(hlcd->port_rst, hlcd->pin_rst, GPIO_PIN_SET);
    HAL_Delay(20);

    /* PCD8544 Initialization Sequence */
    LCD_Write(hlcd, 0x21, 0); // Extended instructions (H=1)
    LCD_Write(hlcd, 0xA8, 0); // Set VOP (Contrast) - 0xA8 is very safe/low
    LCD_Write(hlcd, 0x04, 0); // Temp coefficient
    LCD_Write(hlcd, 0x14, 0); // Bias mode 1:48
    LCD_Write(hlcd, 0x20, 0); // Basic instructions (H=0, Horizontal)
    LCD_Write(hlcd, 0x0C, 0); // Normal display mode

    LCD_Clear(hlcd);
    LCD_Update(hlcd);
}

void LCD_Clear(LCD_Handle_t *hlcd) {
    memset(hlcd->buffer, 0, LCD_BUFFER_SIZE);
}

void LCD_Update(LCD_Handle_t *hlcd) {
    LCD_Write(hlcd, 0x80, 0); // Set X address to 0
    LCD_Write(hlcd, 0x40, 0); // Set Y address to 0
    
    HAL_GPIO_WritePin(hlcd->port_dc, hlcd->pin_dc, 1); // Data mode
    HAL_GPIO_WritePin(hlcd->port_ce, hlcd->pin_ce, GPIO_PIN_RESET);
    
    HAL_SPI_Transmit(hlcd->hspi, hlcd->buffer, LCD_BUFFER_SIZE, 100);
    
    while (HAL_SPI_GetState(hlcd->hspi) == HAL_SPI_STATE_BUSY);
    HAL_GPIO_WritePin(hlcd->port_ce, hlcd->pin_ce, GPIO_PIN_SET);
}

void LCD_DrawPixel(LCD_Handle_t *hlcd, uint8_t x, uint8_t y, bool on) {
    if (x >= LCD_WIDTH || y >= LCD_HEIGHT) return;
    
    uint16_t index = x + (y / 8) * LCD_WIDTH;
    if (on) {
        hlcd->buffer[index] |= (1 << (y % 8));
    } else {
        hlcd->buffer[index] &= ~(1 << (y % 8));
    }
}

void LCD_DrawString(LCD_Handle_t *hlcd, uint8_t x, uint8_t y, const char *str) {
    while (*str) {
        uint8_t c = *str;
        if (c < 32 || c > 126) c = ' '; // Map to space if out of range
        
        // Safety: If we go past the end of our current table (z), map to '?'
        if (c - 32 >= (sizeof(font_5x7)/sizeof(font_5x7[0]))) {
            c = '?';
        }
        
        c -= 32; // Offset for font table

        // Each character in the font table is 5 bytes wide
        for (uint8_t i = 0; i < 5; i++) {
            uint8_t column = font_5x7[c][i];
            for (uint8_t j = 0; j < 8; j++) {
                if (column & (1 << j)) {
                    LCD_DrawPixel(hlcd, x + i, y + j, true);
                } else {
                    LCD_DrawPixel(hlcd, x + i, y + j, false);
                }
            }
        }
        
        // Add 1-pixel space between characters
        for (uint8_t j = 0; j < 8; j++) {
            LCD_DrawPixel(hlcd, x + 5, y + j, false);
        }

        str++;
        x += 6; // Move to next character (5 pixels + 1 space)
        if (x > LCD_WIDTH - 6) break;
    }
}
